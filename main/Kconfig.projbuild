## main/Kconfig.projbuild
```kconfig
menu "KeyValet configuration"

    config KEYVALET_LOCK_RECOVERY_MS
        int "Lock recovery interval (ms)"
        range 100 10000
        default 2000
        help
            Provisional quiet interval after every lock pulse. Requests
            are rejected during this interval. Bench measurements must validate
            or revise this value before dual-load operation is accepted.

    config KEYVALET_DIAGNOSTICS
        bool "Enable development USB hardware-test commands"
        default n
        help
            Enables the deliberately formatted USB Serial/JTAG command
            interface used for workbench hardware acceptance tests, including
            guarded finite solenoid pulse commands. Keep this disabled in
            production firmware. Narrow Improv USB Wi-Fi provisioning is
            always available and does not depend on this diagnostic option.

endmenu
```

## sdkconfig.defaults
```kconfig
# Reproducible KeyValet baseline for ESP-IDF v5.5.5.
CONFIG_IDF_TARGET="esp32c6"
CONFIG_ESPTOOLPY_FLASHSIZE_8MB=y
CONFIG_ESPTOOLPY_FLASHSIZE="8MB"
CONFIG_PARTITION_TABLE_CUSTOM=y
CONFIG_PARTITION_TABLE_CUSTOM_FILENAME="partitions.csv"
CONFIG_PARTITION_TABLE_FILENAME="partitions.csv"
CONFIG_ESP_CONSOLE_UART_DEFAULT=y
CONFIG_ESP_CONSOLE_SECONDARY_USB_SERIAL_JTAG=y
CONFIG_HTTPD_WS_SUPPORT=y
CONFIG_HTTPD_WS_PRE_HANDSHAKE_CB_SUPPORT=y
CONFIG_HTTPD_WS_POST_HANDSHAKE_CB_SUPPORT=y
# CONFIG_KEYVALET_DIAGNOSTICS is not set
```
